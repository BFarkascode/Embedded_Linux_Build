## build/conf/bblayers.conf
```bitbake
# POKY_BBLAYERS_CONF_VERSION is increased each time build/conf/bblayers.conf
# changes incompatibly
POKY_BBLAYERS_CONF_VERSION = "2"

BBPATH = "${TOPDIR}"
BBFILES ?= ""

BBLAYERS ?= " \
  /home/ub110/Projects/yocto/poky/meta \
  /home/ub110/Projects/yocto/poky/meta-poky \
  /home/ub110/Projects/yocto/poky/meta-yocto-bsp \
  /home/ub110/Projects/yocto/meta-openembedded/meta-oe \
  /home/ub110/Projects/yocto/meta-openembedded/meta-python \
  /home/ub110/Projects/yocto/meta-st-stm32mp \
  "
```
